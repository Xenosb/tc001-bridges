## CMakeLists.txt
```
# SPDX-License-Identifier: GPL-3.0-or-later

cmake_minimum_required(VERSION 3.28.0)

# Optional local overrides (Kconfig fragment), not committed
if(EXISTS ${CMAKE_CURRENT_SOURCE_DIR}/local.conf)
  list(APPEND EXTRA_CONF_FILE ${CMAKE_CURRENT_SOURCE_DIR}/local.conf)
endif()

find_package(Zephyr REQUIRED HINTS $ENV{ZEPHYR_BASE})
project(tc001_bridges)

# The HTTP server keeps each service's resources in a section of its own
zephyr_linker_sources(SECTIONS sections-rom.ld)
zephyr_linker_section(
  NAME http_resource_desc_portal_service
  KVMA RAM_REGION GROUP RODATA_REGION
)

target_sources(app PRIVATE
  src/app_battery.c
  src/app_bridges.c
  src/app_clock.c
  src/app_screensaver.c
  src/app_settings.c
  src/app_trends.c
  src/battery.c
  src/brightness.c
  src/brightness_curve.c
  src/battery_percent.c
  src/clock.c
  src/color.c
  src/config.c
  src/font3x5.c
  src/form.c
  src/format.c
  src/gfx.c
  src/history.c
  src/history_core.c
  src/https.c
  src/icons.c
  src/light.c
  src/location.c
  src/logos.c
  src/main.c
  src/portal.c
  src/power.c
  src/power_core.c
  src/qt_logo.c
  src/resp_scan.c
  src/scroll.c
  src/setup.c
  src/stats.c
  src/timeconv.c
  src/ui.c
  src/weather.c
  src/wifi.c
  src/wmo.c
)

# Root certificates the HTTPS client trusts, embedded as C arrays
foreach(cert usertrust_ecc_root globalsign_r3_root digicert_global_g2_root gts_root_r4 isrg_root_x1)
  generate_inc_file_for_target(app
    certs/${cert}.der
    ${ZEPHYR_BINARY_DIR}/include/generated/${cert}.der.inc
  )
endforeach()
```

## Kconfig
```
# Copyright (c) 2026 Bruno Vunderl
# SPDX-License-Identifier: GPL-3.0-or-later

mainmenu "TC001 Bridges"

config TC001_AP_SSID
	string "Setup access point name"
	default "TC001-Bridges"
	help
	  Network the clock creates when it cannot join a saved network.

config TC001_AP_PSK
	string "Setup access point password"
	default "tc001bridges"
	help
	  WPA2 password of the setup access point, 8 to 63 characters. The Wi-Fi
	  password entered on the setup page travels over this link, so a
	  password is used by default. Leave empty for an open network.

config TC001_AP_IP
	string "Setup access point IPv4 address"
	default "192.168.4.1"
	help
	  Address of the clock while the setup access point is up, and of its web
	  page. The DHCP server hands out addresses ten above this one.

config TC001_STATS_REFRESH_S
	int "Refresh interval in seconds"
	default 300
	help
	  How often GitHub, crates.io and NuGet are queried again. A refresh makes
	  five HTTPS requests. GitHub allows 60 unauthenticated requests per hour,
	  and each refresh uses two, so keep this at 120 seconds or more.

config TC001_BRIGHTNESS
	int "LED brightness in percent"
	range 1 100
	default 40
	help
	  All 256 LEDs at full white would draw several amps, more than USB
	  provides, so everything drawn is scaled down.

config TC001_BATTERY_UV_PER_COUNT
	int "Battery voltage per ADC count, in microvolts"
	default 1980
	help
	  The battery is measured through a resistor divider on GPIO34 and the ESP32's ADC is not
	  very linear, so this is an estimate: about 1.98 mV of battery voltage per count. It was
	  worked out with the battery charged and the clock on USB, reading about 2098 counts for
	  roughly 4.15 V. If the percentage looks off, adjust it: the battery voltage is the raw
	  count times this value.

config TC001_LDR_DARK_COUNT
	int "Light sensor count in the dark"
	default 3000
	help
	  Automatic brightness maps the ambient light sensor's ADC count (0 to 4095) onto the display
	  brightness on a logarithmic scale: this count is the dimmest setting. The photoresistor
	  reads a LOW count in bright light on this clock, so the dark count is the higher one. If
	  the display gets dimmer when you shine light on the sensor, swap these two values.
	  In a normal evening room the sensor reads about 400.

config TC001_LDR_BRIGHT_COUNT
	int "Light sensor count in bright light"
	default 150
	help
	  The count at which the display is at full brightness. See the dark count above.

config TC001_DISPLAY_OFF_S
	int "Turn the display off after this many seconds on battery"
	default 120
	range 0 3600
	help
	  When the clock seems to be running from its battery rather than external power (guessed from
	  how the battery voltage moves, there is no signal for it) and nobody has pressed a button for
	  this long, the display goes dark to save the battery. Any button press turns it back on, and
	  that press does nothing else. It also comes back by itself when the clock is plugged in.
	  0 keeps the display on always.

source "Kconfig.zephyr"
```

## prj.conf
```kconfig
CONFIG_LOG=y

CONFIG_MAIN_STACK_SIZE=6144

# Display: drawn directly into a framebuffer (see src/gfx.c)
CONFIG_DISPLAY=y

# Buttons
CONFIG_INPUT=y

# Battery voltage and the light sensor
CONFIG_ADC=y

# Time: NTP over Wi-Fi, kept in the battery-backed DS1307 for the next boot
CONFIG_SNTP=y
CONFIG_NET_UDP=y
CONFIG_RTC=y

# Network: Wi-Fi station querying GitHub, crates.io and NuGet over HTTPS, plus a setup
# access point (with DHCP server and web page) when no saved network works
CONFIG_NETWORKING=y
CONFIG_WIFI=y
CONFIG_WIFI_NM=y
CONFIG_WIFI_USAGE_MODE_STA_AP=y
CONFIG_NET_L2_ETHERNET=y
CONFIG_NET_L2_WIFI_MGMT=y
CONFIG_NET_IPV4=y
CONFIG_NET_IPV6=n
CONFIG_NET_IF_MAX_IPV4_COUNT=2
CONFIG_NET_TCP=y
CONFIG_NET_UDP=y
CONFIG_NET_DHCPV4=y
CONFIG_NET_DHCPV4_SERVER=y
CONFIG_NET_SOCKETS=y
CONFIG_DNS_RESOLVER=y
CONFIG_NET_DHCPV4_OPTION_DNS_ADDRESS=y
CONFIG_NET_MGMT_EVENT_INFO=y
CONFIG_NET_MGMT_EVENT_STACK_SIZE=4096
CONFIG_NET_MGMT_EVENT_QUEUE_SIZE=16
CONFIG_NET_MGMT_EVENT_QUEUE_TIMEOUT=5000
CONFIG_NET_PKT_RX_COUNT=16
CONFIG_NET_PKT_TX_COUNT=16
CONFIG_NET_BUF_RX_COUNT=32
CONFIG_NET_BUF_TX_COUNT=32
# Sockets that were just closed keep their slot for a moment (TCP TIME_WAIT), and the clock opens
# several in quick succession (NTP, location, weather, then the four stats requests)
CONFIG_NET_MAX_CONTEXTS=16
CONFIG_NET_MAX_CONN=16

# Saved networks live in flash (settings on NVS, "storage" partition)
CONFIG_FLASH=y
CONFIG_FLASH_MAP=y
CONFIG_NVS=y
CONFIG_SETTINGS=y
CONFIG_SETTINGS_NVS=y
CONFIG_WIFI_CREDENTIALS=y
CONFIG_WIFI_CREDENTIALS_MAX_ENTRIES=8

# Setup web page
CONFIG_HTTP_SERVER=y
CONFIG_HTTP_SERVER_MAX_CLIENTS=2
CONFIG_HTTP_SERVER_CLIENT_BUFFER_SIZE=512
CONFIG_HTTP_SERVER_STACK_SIZE=6144
CONFIG_REBOOT=y

# TLS 1.2 client with certificate verification against the embedded roots.
# GitHub sends its ~7 KB answer in one TLS record, hence the 8 KB input buffer.
CONFIG_MBEDTLS=y
CONFIG_MBEDTLS_ENABLE_HEAP=y
CONFIG_MBEDTLS_HEAP_SIZE=45000
CONFIG_MBEDTLS_SSL_IN_CONTENT_LEN=8192
CONFIG_MBEDTLS_SSL_OUT_CONTENT_LEN=1024
CONFIG_NET_SOCKETS_SOCKOPT_TLS=y
CONFIG_NET_SOCKETS_TLS_MAX_CONTEXTS=2
CONFIG_TLS_CREDENTIALS=y
# One slot per trusted root certificate (see certs/README.md)
CONFIG_TLS_MAX_CREDENTIALS_NUMBER=8
# crates.io and NuGet sit behind shared CDN/cloud addresses that pick the certificate by SNI
CONFIG_MBEDTLS_SSL_SERVER_NAME_INDICATION=y
# GitHub's chain is anchored by the P-384 USERTrust ECC root
CONFIG_PSA_WANT_ECC_SECP_R1_384=y
CONFIG_MBEDTLS_CIPHERSUITE_TLS_ECDHE_ECDSA_WITH_AES_128_GCM_SHA256=y
CONFIG_MBEDTLS_CIPHERSUITE_TLS_ECDHE_RSA_WITH_AES_128_GCM_SHA256=y
CONFIG_MBEDTLS_CIPHERSUITE_TLS_ECDHE_RSA_WITH_AES_256_GCM_SHA384=y
CONFIG_MBEDTLS_CIPHERSUITE_TLS_ECDHE_ECDSA_WITH_AES_256_GCM_SHA384=y
```

## src/main.c
```c
/*
 * Copyright (c) 2026 Bruno Vunderl
 *
 * SPDX-License-Identifier: GPL-3.0-or-later
 */

#include <stdio.h>

#include <zephyr/dt-bindings/input/input-event-codes.h>
#include <zephyr/input/input.h>
#include <zephyr/kernel.h>
#include <zephyr/logging/log.h>
#include <zephyr/sys/reboot.h>

#include "battery.h"
#include "brightness.h"
#include "clock.h"
#include "config.h"
#include "history.h"
#include "https.h"
#include "light.h"
#include "location.h"
#include "portal.h"
#include "setup.h"
#include "stats.h"
#include "ui.h"
#include "weather.h"
#include "wifi.h"

LOG_MODULE_REGISTER(main, LOG_LEVEL_INF);

#define RETRY_DELAY_S 30

#define SECOND_MS 1000

/* Everything the clock fetches over the network. One request at a time: TLS memory allows no more. */
struct task {
	const char *name;
	int (*run)(void);
	int interval_s; /* until the next run after a success */
	int retry_s;    /* until the next run after a failure */
	int64_t next_ms;
};

static int run_time(void)
{
	return clock_sync();
}

static int run_location(void)
{
	return location_refresh();
}

static int run_weather(void)
{
	return weather_refresh();
}

static int run_stats(void)
{
	struct stat_item items[STATS_MAX_ITEMS];
	size_t count;
	int ret = stats_refresh(items, &count);

	if (ret == 0) {
		history_record_items(items, count);
		ui_set_items(items, count);
	}
	return ret;
}

/* In the order they run at start: the time first, and the weather needs the location */
static struct task tasks[] = {
	{"time", run_time, 60 * 60, 60},
	{"location", run_location, 12 * 60 * 60, 5 * 60},
	{"weather", run_weather, 30 * 60, 5 * 60},
	{"stats", run_stats, CONFIG_TC001_STATS_REFRESH_S, RETRY_DELAY_S},
};

/* Run whatever is due, then sleep until the next thing is */
static void run_tasks_forever(void)
{
	while (1) {
		int64_t soonest = INT64_MAX;

		for (size_t i = 0; i < ARRAY_SIZE(tasks); i++) {
			struct task *t = &tasks[i];

			if (k_uptime_get() >= t->next_ms) {
				int ret = t->run();

				if (ret) {
					LOG_WRN("Task %s failed (%d), trying again in %d s", t->name, ret,
						t->retry_s);
				}
				t->next_ms = k_uptime_get() +
					     (int64_t)(ret ? t->retry_s : t->interval_s) * SECOND_MS;
			}
			soonest = MIN(soonest, t->next_ms);
		}

		k_sleep(K_MSEC(CLAMP(soonest - k_uptime_get(), 100, 60 * SECOND_MS)));
	}
}

/*
 * Left/right switch between apps, the middle button does whatever the current app defines. While
 * the setup access point is up it ends the setup instead.
 */
static void button_cb(struct input_event *evt, void *user_data)
{
	ARG_UNUSED(user_data);

	if (evt->type != INPUT_EV_KEY || !evt->value) {
		return;
	}
	if (ui_activity()) {
		return; /* the display was off: this press only turned it on */
	}

	switch (evt->code) {
	case INPUT_KEY_LEFT:
		ui_step(-1);
		break;
	case INPUT_KEY_RIGHT:
		ui_step(1);
		break;
	case INPUT_KEY_ENTER:
		if (setup_active()) {
			setup_cancel();
		} else {
			ui_middle();
		}
		break;
	default:
		break;
	}
}
INPUT_CALLBACK_DEFINE(NULL, button_cb, NULL);

int main(void)
{
	int ret;

	config_init();
	location_init();
	clock_init();
	history_init();
	battery_init();
	light_init();
	brightness_init();

	ret = ui_init();
	if (ret) {
		LOG_ERR("UI init failed: %d", ret);
		return ret;
	}

	ui_set_status("SCAN");
	ret = wifi_connect_saved();
	if (ret) {
		LOG_WRN("No Wi-Fi connection (%d), starting the setup access point", ret);
		setup_boot(); /* returns if the middle button cancelled it, to show the apps below */
	}

	ui_start_apps();

	ret = https_init();
	if (ret) {
		LOG_ERR("HTTPS init failed: %d", ret);
		ui_set_status("FAIL");
		return ret;
	}

	/* The settings page: browse to the clock's address, which the device menu will show */
	portal_start();

	run_tasks_forever();

	return 0;
}
```

## src/app.h
```c
/*
 * Copyright (c) 2026 Bruno Vunderl
 *
 * SPDX-License-Identifier: GPL-3.0-or-later
 */

#ifndef TC001_APP_H_
#define TC001_APP_H_

#include <stdbool.h>
#include <stdint.h>

#include "gfx.h"
#include "stats.h"

/*
 * A screen of the clock. The display thread calls update() every tick, with the UI lock held,
 * and enter() whenever the user switches to the app, so an app needs no locking of its own for
 * state that only these callbacks touch.
 */

enum app_result {
	APP_IDLE,     /* nothing changed, keep showing the last frame */
	APP_REDRAW,   /* the frame in @p fb replaces what is shown, immediately */
	APP_SLIDE_UP, /* the frame in @p fb slides up into view, as one page replaces another */
};

struct app {
	/**
	 * A word shown once when the user switches to the app, before its pages start. NULL for none.
	 * Upper case, at most eight characters.
	 */
	const char *title;

	/** Called when the app becomes the visible one. The next update() must return a frame. */
	void (*enter)(int64_t now);

	/** Called every tick. Draw into @p fb (already cleared) and say what to do with it. */
	enum app_result (*update)(struct gfx_fb *fb, int64_t now);

	/** The middle button was pressed. May be NULL. */
	void (*middle)(int64_t now);

	/**
	 * Left (-1) or right (+1) was pressed. Return true if the app used it, for example to move
	 * through a menu, and false to let it switch to the next or previous app. May be NULL.
	 */
	bool (*nav)(int direction, int64_t now);
};

/** New bridge numbers for the "bridges total" app. Call with the UI lock held (see ui_set_items). */
void app_bridges_set_items(const struct stat_item *items, size_t count);

/** New bridge numbers for the "bridges trends" app. Call with the UI lock held. */
void app_trends_set_items(const struct stat_item *items, size_t count);

extern const struct app app_clock;
extern const struct app app_battery;
extern const struct app app_settings;
extern const struct app app_bridges_trends;
extern const struct app app_bridges_total;
extern const struct app app_screensaver;

#endif /* TC001_APP_H_ */
```

## src/app_battery.c
```c
/*
 * Copyright (c) 2026 Bruno Vunderl
 *
 * SPDX-License-Identifier: GPL-3.0-or-later
 */

/*
 * Battery level: a battery symbol filled to the charge, and the percentage beside it. While the
 * battery seems to be charging, the rightmost column is a yellow bar with a dark block travelling
 * up it, round and round.
 *
 * The clock has no signal that says it is charging, so this is inferred from the voltage: a battery
 * on the charger sits at or near full voltage, or climbs. It can be wrong for a while, for example
 * just after unplugging a full battery.
 */

#include <stdio.h>
#include <string.h>

#include <zephyr/kernel.h>

#include "app.h"
#include "power.h"

#define COLOR_OUTLINE 0xb0b0b0
#define COLOR_GOOD    0x64dc8c
#define COLOR_LOW     0xffc83c
#define COLOR_EMPTY   0xff5050
#define COLOR_TEXT    0xffffff
#define COLOR_BAR     0xffd23c

/* The battery is centered in the display height, with a 1 px gap top and bottom: a 12 pixel body
 * and a 2 pixel terminal
 */
#define BATTERY_W        16
#define BATTERY_H        6
#define BATTERY_Y        1 /* to center it: GFX_H is 8 */
#define INTERIOR_W       12 /* columns 1 to 12 */
#define TEXT_LEFT        BATTERY_W
#define TEXT_AREA        (GFX_W - 1 - TEXT_LEFT) /* up to the column before the charging bar */

/* The charging bar: the last column, with a dark block moving up it */
#define BAR_X        (GFX_W - 1)
#define BAR_BLOCK    3
#define BAR_STEP_MS  120

static const char *const battery_shape[BATTERY_H] = {
	"XXXXXXXXXXXXXX..",
	"X............X..",
	"X............XXX",
	"X............XXX",
	"X............X..",
	"XXXXXXXXXXXXXX..",
};

static bool redraw;
static int drawn_bar_step = -1;
static int drawn_percent = -1;
static bool drawn_charging;
static bool drawn_have;

/* Which position of the charging animation it is at @p now */
static int bar_step(int64_t now)
{
	return (now / BAR_STEP_MS) % GFX_H;
}

static void draw(struct gfx_fb *fb, int64_t now)
{
	int percent = power_percent();
	bool charging = power_external();
	char text[8];
	int filled = (percent * INTERIOR_W + 50) / 100;
	uint32_t color = percent > 50 ? COLOR_GOOD : (percent > 20 ? COLOR_LOW : COLOR_EMPTY);
	int step = bar_step(now);

	if (percent > 0 && filled == 0) {
		filled = 1; /* almost empty is not the same as empty */
	}

	gfx_mask(fb, 0, BATTERY_Y, battery_shape, BATTERY_H, COLOR_OUTLINE);
	for (int col = 0; col < filled; col++) {
		for (int row = 1; row < BATTERY_H - 1; row++) {
			gfx_pixel(fb, 1 + col, BATTERY_Y + row, color);
		}
	}

	snprintf(text, sizeof(text), "%d", percent);
	gfx_text(fb, TEXT_LEFT + (TEXT_AREA - gfx_text_width(text)) / 2, 1, text, COLOR_TEXT);

	if (charging) {
		/* The dark block's top row moves up by one each step and wraps round the column */
		int top = (GFX_H - 1) - step;

		for (int row = 0; row < GFX_H; row++) {
			if ((row - top + GFX_H) % GFX_H >= BAR_BLOCK) {
				gfx_pixel(fb, BAR_X, row, COLOR_BAR);
			}
		}
	}
	drawn_bar_step = step;
	drawn_percent = percent;
	drawn_charging = charging;
}

static void enter(int64_t now)
{
	ARG_UNUSED(now);
	redraw = true;
}

static enum app_result update(struct gfx_fb *fb, int64_t now)
{
	bool have = power_have_reading();

	/* Redraw when what is shown is out of date: a new reading, or the charging bar moved on */
	if (have != drawn_have || (have && (power_percent() != drawn_percent ||
					   power_external() != drawn_charging)) ||
	    (have && power_external() && bar_step(now) != drawn_bar_step)) {
		redraw = true;
	}

	if (!redraw) {
		return APP_IDLE;
	}
	redraw = false;
	drawn_have = have;

	if (!have) {
		gfx_text(fb, (GFX_W - gfx_text_width("N/A")) / 2, 1, "N/A", 0x505050);
	} else {
		draw(fb, now);
	}
	return APP_REDRAW;
}

const struct app app_battery = {
	.title = "BATTERY",
	.enter = enter,
	.update = update,
};
```

## src/app_bridges.c
```c
/*
 * Copyright (c) 2026 Bruno Vunderl
 *
 * SPDX-License-Identifier: GPL-3.0-or-later
 */

/*
 * "Bridges total": a title, then the stars and downloads of both bridges, each as a logo with
 * its number beside it. The pages rotate on their own; the middle button pauses that.
 */

#include <string.h>

#include <zephyr/kernel.h>

#include "app.h"
#include "format.h"
#include "icons.h"
#include "logos.h"

#define STAT_HOLD_MS  3500

#define COLOR_NOTE  0x787878
#define COLOR_PAUSE 0x404040
#define COLOR_STAR  0xffd23c
#define COLOR_ARROW 0x64dc8c

/* Pages, in the order they rotate after the title */
static const struct {
	enum stat_bridge bridge;
	enum stat_metric metric;
	const uint8_t *logo;
	uint32_t color;
} page_order[] = {
	{STAT_BRIDGE_CSHARP, STAT_METRIC_STARS, logo_csharp, 0xb978ff},
	{STAT_BRIDGE_RUST, STAT_METRIC_STARS, logo_rust, 0xff6e1e},
	{STAT_BRIDGE_CSHARP, STAT_METRIC_DOWNLOADS, logo_nuget, 0xb978ff},
	{STAT_BRIDGE_RUST, STAT_METRIC_DOWNLOADS, logo_crate, 0xff6e1e},
};

static bool is_stars(enum stat_metric metric)
{
	return metric == STAT_METRIC_STARS;
}

struct page {
	const uint8_t *logo;
	const char *const *icon; /* star for stars, down arrow for downloads */
	uint32_t icon_color;
	uint32_t color;
	uint32_t value;
};

#define MAX_PAGES ARRAY_SIZE(page_order)

static struct page pages[MAX_PAGES];
static size_t page_count;
static size_t page_index;
static bool paused;
static bool redraw;
static bool first; /* the next frame is the first after enter(): show it without a slide */
static int64_t next_switch;

static void draw_page(struct gfx_fb *fb, const struct page *p)
{
	char number[12];
	int group_width, x;

	format_count(number, sizeof(number), p->value);
	gfx_sprite(fb, 0, 0, p->logo);

	/* Centre the number and its icon, one pixel apart, in the 23 pixels right of the logo */
	group_width = gfx_text_width(number) + 1 + ICON_W;
	x = 9 + (GFX_W - 9 - group_width) / 2;
	gfx_text(fb, x, 1, number, p->color);
	gfx_mask(fb, x + gfx_text_width(number) + 1, 1, p->icon, ICON_H, p->icon_color);

	if (paused) {
		gfx_pixel(fb, GFX_W - 1, 0, COLOR_PAUSE);
	}
}

void app_bridges_set_items(const struct stat_item *items, size_t count)
{
	struct page next[MAX_PAGES];
	size_t n = 0;

	for (size_t p = 0; p < ARRAY_SIZE(page_order); p++) {
		for (size_t i = 0; i < count; i++) {
			if (items[i].bridge == page_order[p].bridge &&
			    items[i].metric == page_order[p].metric) {
				next[n++] = (struct page){
					.logo = page_order[p].logo,
					.icon = is_stars(page_order[p].metric) ? icon_star
									       : icon_arrow_down,
					.icon_color = is_stars(page_order[p].metric) ? COLOR_STAR
										     : COLOR_ARROW,
					.color = page_order[p].color,
					.value = items[i].value,
				};
				break;
			}
		}
	}
	if (n == 0) {
		/* Nothing usable in this update: keep whatever is already showing */
		return;
	}

	memcpy(pages, next, n * sizeof(next[0]));
	if (page_count == 0) {
		page_index = 0;
		first = true;
	}
	page_count = n;
	page_index %= page_count;
	redraw = true;
}

static void enter(int64_t now)
{
	first = true;
	next_switch = now + (page_count ? STAT_HOLD_MS : 0);
}

static enum app_result update(struct gfx_fb *fb, int64_t now)
{
	if (page_count == 0) {
		/* No data yet */
		if (first || redraw) {
			gfx_text(fb, (GFX_W - gfx_text_width("SYNC")) / 2, 1, "SYNC", COLOR_NOTE);
			first = redraw = false;
			return APP_REDRAW;
		}
		return APP_IDLE;
	}

	if (first) {
		draw_page(fb, &pages[page_index]);
		first = redraw = false;
		next_switch = now + STAT_HOLD_MS;
		return APP_REDRAW;
	}

	if (!paused && now >= next_switch) {
		page_index = (page_index + 1) % page_count;
		draw_page(fb, &pages[page_index]);
		next_switch = now + STAT_HOLD_MS;
		redraw = false;
		return APP_SLIDE_UP;
	}

	if (redraw) {
		/* New numbers, or the pause marker changed: same page, no slide */
		draw_page(fb, &pages[page_index]);
		redraw = false;
		return APP_REDRAW;
	}

	return APP_IDLE;
}

static void middle(int64_t now)
{
	paused = !paused;
	/* Resuming gives the page on display its full time again */
	next_switch = now + (page_count ? STAT_HOLD_MS : 0);
	redraw = true;
}

const struct app app_bridges_total = {
	.title = "TOTAL",
	.enter = enter,
	.update = update,
	.middle = middle,
};
```

## src/app_clock.c
```c
/*
 * Copyright (c) 2026 Bruno Vunderl
 *
 * SPDX-License-Identifier: GPL-3.0-or-later
 */

/*
 * Clock and weather: the time, the date and the current weather, one after the other. The time
 * page follows the minute. The middle button pauses the rotation.
 */

#include <string.h>

#include <zephyr/kernel.h>

#include "app.h"
#include "clock.h"
#include "config.h"
#include "format.h"
#include "logos.h"
#include "weather.h"
#include "wmo.h"

#define TIME_HOLD_MS    7000
#define DATE_HOLD_MS    3000
#define WEATHER_HOLD_MS 4000

#define COLOR_TIME   0xffffff
#define COLOR_DATE   0x80c8ff
#define COLOR_UNSET  0x505050
#define COLOR_PAUSE  0x404040

enum page {
	PAGE_TIME,
	PAGE_DATE,
	PAGE_WEATHER,
	PAGE_COUNT,
};

static enum page page;
static int64_t page_start;
static bool first;
static bool redraw;
static bool paused;
static char drawn_time[12]; /* what the time page last showed, to spot the minute changing */

static bool page_available(enum page p)
{
	struct weather w;

	switch (p) {
	case PAGE_DATE:
		return clock_is_set();
	case PAGE_WEATHER:
		return weather_get(&w);
	default:
		return true;
	}
}

static enum page next_page(enum page from)
{
	for (int i = 1; i <= PAGE_COUNT; i++) {
		enum page p = (from + i) % PAGE_COUNT;

		if (page_available(p)) {
			return p;
		}
	}
	return from;
}

static void time_text(char *buf, size_t len)
{
	struct civil_time t;

	if (clock_local(&t)) {
		format_time(buf, len, t.hour, t.minute, config_get()->time_format == TIME_12H);
	} else {
		strncpy(buf, "--:--", len);
	}
}

static void date_text(char *buf, size_t len)
{
	struct civil_time t;

	if (clock_local(&t)) {
		format_date(buf, len, t.month, t.day, config_get()->date_format);
	} else {
		buf[0] = '\0';
	}
}

static uint32_t temperature_color(int tenths)
{
	if (tenths <= 0) {
		return 0x78beff; /* freezing */
	} else if (tenths <= 100) {
		return 0xb4dcff; /* cold */
	} else if (tenths <= 200) {
		return 0xffffff; /* mild */
	} else if (tenths <= 280) {
		return 0xffd23c; /* warm */
	}
	return 0xff6428; /* hot */
}

static const uint8_t *weather_icon(const struct weather *w)
{
	switch (wmo_kind(w->code, w->is_day)) {
	case WX_SUN:
		return logo_wx_sun;
	case WX_MOON:
		return logo_wx_moon;
	case WX_PARTLY:
		return logo_wx_partly;
	case WX_FOG:
		return logo_wx_fog;
	case WX_RAIN:
		return logo_wx_rain;
	case WX_SNOW:
		return logo_wx_snow;
	case WX_STORM:
		return logo_wx_storm;
	case WX_CLOUD:
	default:
		return logo_wx_cloud;
	}
}

static void draw_centered(struct gfx_fb *fb, const char *text, uint32_t color)
{
	gfx_text(fb, (GFX_W - gfx_text_width(text)) / 2, 1, text, color);
}

static void draw_page(struct gfx_fb *fb)
{
	char text[16];
	struct weather w;

	switch (page) {
	case PAGE_TIME:
		time_text(text, sizeof(text));
		strncpy(drawn_time, text, sizeof(drawn_time));
		draw_centered(fb, text, clock_is_set() ? COLOR_TIME : COLOR_UNSET);
		break;

	case PAGE_DATE:
		date_text(text, sizeof(text));
		draw_centered(fb, text, COLOR_DATE);
		break;

	case PAGE_WEATHER:
		if (weather_get(&w)) {
			format_temperature(text, sizeof(text), w.temperature);
			gfx_sprite(fb, 0, 0, weather_icon(&w));
			/* Centre the temperature in the 23 pixels right of the icon */
			gfx_text(fb, 9 + (GFX_W - 9 - gfx_text_width(text)) / 2, 1, text,
				 temperature_color(w.temperature));
		}
		break;

	default:
		break;
	}

	if (paused) {
		gfx_pixel(fb, GFX_W - 1, 0, COLOR_PAUSE);
	}
}

static bool page_finished(int64_t now)
{
	int64_t elapsed = now - page_start;

	switch (page) {
	case PAGE_TIME:
		return elapsed >= TIME_HOLD_MS;
	case PAGE_DATE:
		return elapsed >= DATE_HOLD_MS;
	default:
		return elapsed >= WEATHER_HOLD_MS;
	}
}

static void enter(int64_t now)
{
	first = true;
	page = PAGE_TIME;
	page_start = now;
}

static enum app_result update(struct gfx_fb *fb, int64_t now)
{
	char text[16];

	if (first) {
		first = redraw = false;
		page_start = now; /* counted from here, not from enter(): a title may have come first */
		draw_page(fb);
		return APP_REDRAW;
	}

	if (!paused && page_finished(now)) {
		enum page next = next_page(page);

		page_start = now;
		if (next == page) {
			return APP_IDLE; /* the only page there is: nothing to slide to */
		}
		page = next;
		draw_page(fb);
		return APP_SLIDE_UP;
	}

	if (redraw) {
		redraw = false;
		draw_page(fb);
		return APP_REDRAW;
	}

	if (page == PAGE_TIME) {
		/* The time page follows the clock: redraw when the minute (or the format) changes */
		time_text(text, sizeof(text));
		if (strcmp(text, drawn_time) != 0) {
			draw_page(fb);
			return APP_REDRAW;
		}
	}

	return APP_IDLE;
}

static void middle(int64_t now)
{
	paused = !paused;
	/* Resuming gives the page on display its full time again */
	page_start = now;
	redraw = true;
}

const struct app app_clock = {
	.title = "TIME",
	.enter = enter,
	.update = update,
	.middle = middle,
};
```

## src/app_screensaver.c
```c
/*
 * Copyright (c) 2026 Bruno Vunderl
 *
 * SPDX-License-Identifier: GPL-3.0-or-later
 */

/*
 * Screen saver: the Qt badge, either steady in green, steady in white, or with its colour drifting
 * around the colour wheel. The middle button changes the mode, and the choice is remembered.
 */

#include "app.h"
#include "color.h"
#include "config.h"
#include "qt_logo.h"

/*
 * The Qt green is #41cd52, but LEDs are driven with linear PWM, so its small red and blue parts look
 * far stronger than their numbers say and wash the green out towards yellow-white. These are red
 * and blue corrected for the eye (gamma 2.2), with the green kept as it was.
 */
#define QT_GREEN       0x11cd1b
#define WHITE          0xffffff
#define COLOR_TICK_MS  90
#define HUE_STEP       2
#define LEFT           ((GFX_W - QT_LOGO_W) / 2)

static bool redraw;
static uint8_t hue;
static int64_t next_change;

static void draw_logo(struct gfx_fb *fb, int left, uint32_t color)
{
	gfx_mask(fb, left, 0, qt_logo, QT_LOGO_H, color);
}

static void enter(int64_t now)
{
	redraw = true;
	next_change = now + COLOR_TICK_MS;
}

static enum app_result update(struct gfx_fb *fb, int64_t now)
{
	switch (config_get()->screensaver) {
	case SAVER_COLORS:
		if (!redraw && now < next_change) {
			return APP_IDLE;
		}
		if (!redraw) {
			hue += HUE_STEP;
			next_change = now + COLOR_TICK_MS;
		}
		draw_logo(fb, LEFT, color_hue(hue));
		break;

	case SAVER_WHITE:
	case SAVER_GREEN:
	default:
		if (!redraw) {
			return APP_IDLE;
		}
		draw_logo(fb, LEFT, config_get()->screensaver == SAVER_WHITE ? WHITE : QT_GREEN);
		break;
	}

	redraw = false;
	return APP_REDRAW;
}

static void middle(int64_t now)
{
	struct config *cfg = config_get();

	cfg->screensaver = (cfg->screensaver + 1) % SAVER_MODE_COUNT;
	config_save();
	enter(now);
}

const struct app app_screensaver = {
	.title = "LOGO",
	.enter = enter,
	.update = update,
	.middle = middle,
};
```

## src/app_settings.c
```c
/*
 * Copyright (c) 2026 Bruno Vunderl
 *
 * SPDX-License-Identifier: GPL-3.0-or-later
 */

/*
 * Settings menu. In the rotation this is a "SETTINGS" card; the middle button opens the menu, where
 * left and right move between the items and the middle button chooses one:
 *
 *   BRIGHTNESS   AUTO on/off, the level (or with AUTO on, a bias from the automatic level),
 *                SET DEFAULT (freezes the current auto level as the manual one), BACK
 *   NETWORK      the network, the address, NEW NET (sets up a network), BACK
 *   EXIT
 *
 * The menu closes by itself after a minute of no button presses. Which apps are shown and the date
 * and time format are set from a browser instead: see portal.c.
 */

#include <stdio.h>
#include <string.h>

#include <zephyr/kernel.h>

#include "app.h"
#include "brightness.h"
#include "config.h"
#include "light.h"
#include "scroll.h"
#include "setup.h"
#include "wifi.h"

#define IDLE_CLOSE_MS 60000
#define LEVEL_STEP    5

#define COLOR_CARD   0xc8c8c8
#define COLOR_ITEM   0x80c8ff
#define COLOR_VALUE  0xffffff
#define COLOR_BACK   0xa0a0a0
#define COLOR_ACTION 0xffc83c

enum menu {
	MENU_CARD, /* not in the menu: the card shown in the rotation */
	MENU_ROOT,
	MENU_BRIGHTNESS,
	MENU_LEVEL, /* adjusting the level: left and right change it */
	MENU_NETWORK,
};

static enum menu menu;
static int index_in_menu;
static int64_t item_start; /* when the item on display appeared, for scrolling */
static int64_t last_press;
static bool redraw;
static int drawn_x;
static bool level_changed;

static int item_count(void)
{
	switch (menu) {
	case MENU_ROOT:
		return 3;
	case MENU_BRIGHTNESS:
		return 4;
	case MENU_NETWORK:
		return 4;
	default:
		return 1;
	}
}

/* The text of the item on display, and the colour to draw it in */
static uint32_t item_text(char *buf, size_t len)
{
	const struct config *cfg = config_get();

	switch (menu) {
	case MENU_ROOT:
		switch (index_in_menu) {
		case 0:
			snprintf(buf, len, "BRIGHTNESS");
			return COLOR_ITEM;
		case 1:
			snprintf(buf, len, "NETWORK");
			return COLOR_ITEM;
		default:
			snprintf(buf, len, "EXIT");
			return COLOR_BACK;
		}

	case MENU_BRIGHTNESS:
		switch (index_in_menu) {
		case 0:
			snprintf(buf, len, cfg->auto_brightness ? "AUTO ON" : "AUTO OFF");
			return COLOR_ITEM;
		case 1:
			if (cfg->auto_brightness) {
				snprintf(buf, len, "BIAS %+d", cfg->brightness_bias);
			} else {
				snprintf(buf, len, "LEVEL %d", cfg->brightness);
			}
			return COLOR_VALUE;
		case 2:
			snprintf(buf, len, "SET DEFAULT");
			return COLOR_ACTION;
		default:
			snprintf(buf, len, "BACK");
			return COLOR_BACK;
		}

	case MENU_LEVEL:
		if (cfg->auto_brightness) {
			snprintf(buf, len, "- %+d +", cfg->brightness_bias);
		} else {
			snprintf(buf, len, "- %d%% +", cfg->brightness);
		}
		return COLOR_VALUE;

	case MENU_NETWORK:
		switch (index_in_menu) {
		case 0:
			snprintf(buf, len, "SSID %s", wifi_ssid()[0] ? wifi_ssid() : "-");
			return COLOR_VALUE;
		case 1:
			snprintf(buf, len, "IP %s", wifi_address()[0] ? wifi_address() : "-");
			return COLOR_VALUE;
		case 2:
			snprintf(buf, len, "NEW NET");
			return COLOR_ACTION;
		default:
			snprintf(buf, len, "BACK");
			return COLOR_BACK;
		}

	default:
		snprintf(buf, len, "SETTINGS");
		return COLOR_CARD;
	}
}

static void go(enum menu to, int index, int64_t now)
{
	menu = to;
	index_in_menu = index;
	item_start = now;
	redraw = true;
}

static void leave_level(void)
{
	if (level_changed) {
		config_save();
		level_changed = false;
	}
}

/* Read the current ambient light and make what it calls for the manual default from now on */
static void set_current_as_default(struct config *cfg)
{
	int raw = light_read();

	if (raw >= 0) {
		int target = brightness_from_light(raw) + cfg->brightness_bias;

		cfg->brightness = CLAMP(target, BRIGHTNESS_MIN, BRIGHTNESS_MAX);
		cfg->auto_brightness = false;
		config_save();
	}
	redraw = true;
}

static void enter(int64_t now)
{
	/* Coming back after the setup display: the menu is where it was left */
	if (menu == MENU_CARD) {
		go(MENU_CARD, 0, now);
	} else {
		redraw = true;
		item_start = now;
	}
	last_press = now;
}

static enum app_result update(struct gfx_fb *fb, int64_t now)
{
	char text[48];
	uint32_t color;
	int x;

	if (menu != MENU_CARD && now - last_press > IDLE_CLOSE_MS) {
		leave_level();
		go(MENU_CARD, 0, now);
	}

	color = item_text(text, sizeof(text));
	x = scroll_x(gfx_text_width(text), GFX_W, now - item_start);

	if (!redraw && x == drawn_x) {
		return APP_IDLE;
	}
	redraw = false;
	drawn_x = x;

	gfx_text(fb, x, 1, text, color);
	return APP_REDRAW;
}

static void middle(int64_t now)
{
	struct config *cfg = config_get();

	last_press = now;

	switch (menu) {
	case MENU_CARD:
		go(MENU_ROOT, 0, now);
		break;

	case MENU_ROOT:
		if (index_in_menu == 0) {
			go(MENU_BRIGHTNESS, 0, now);
		} else if (index_in_menu == 1) {
			go(MENU_NETWORK, 0, now);
		} else {
			go(MENU_CARD, 0, now);
		}
		break;

	case MENU_BRIGHTNESS:
		if (index_in_menu == 0) {
			cfg->auto_brightness = !cfg->auto_brightness;
			config_save();
			redraw = true;
		} else if (index_in_menu == 1) {
			go(MENU_LEVEL, 0, now);
		} else if (index_in_menu == 2) {
			set_current_as_default(cfg);
		} else {
			go(MENU_ROOT, 0, now);
		}
		break;

	case MENU_LEVEL:
		leave_level();
		go(MENU_BRIGHTNESS, 1, now);
		break;

	case MENU_NETWORK:
		if (index_in_menu == 2) {
			/* Open the setup access point next to the connection; the middle button ends it */
			setup_request();
		} else if (index_in_menu == 3) {
			go(MENU_ROOT, 1, now);
		}
		break;
	}
}

static bool nav(int direction, int64_t now)
{
	struct config *cfg = config_get();

	if (menu == MENU_CARD) {
		return false; /* switch to the next app */
	}
	last_press = now;

	if (menu == MENU_LEVEL) {
		if (cfg->auto_brightness) {
			int bias = cfg->brightness_bias + direction * LEVEL_STEP;

			cfg->brightness_bias = CLAMP(bias, -50, 50);
		} else {
			int level = cfg->brightness + direction * LEVEL_STEP;

			cfg->brightness = CLAMP(level, BRIGHTNESS_MIN, BRIGHTNESS_MAX);
		}
		level_changed = true;
		redraw = true;
		return true;
	}

	go(menu, (index_in_menu + direction + item_count()) % item_count(), now);
	return true;
}

const struct app app_settings = {
	.enter = enter,
	.update = update,
	.middle = middle,
	.nav = nav,
};
```

## src/app_trends.c
```c
/*
 * Copyright (c) 2026 Bruno Vunderl
 *
 * SPDX-License-Identifier: GPL-3.0-or-later
 */

/*
 * Bridges trends: how much stars and downloads changed over the last week and the last month, a
 * page each: [logo] W +12 [icon], then [logo] M +40 [icon]. The pages rotate on their own; the
 * middle button pauses that. A change shows as "--" until the daily record reaches back far enough.
 */

#include <string.h>

#include <zephyr/kernel.h>

#include "app.h"
#include "format.h"
#include "history.h"
#include "icons.h"
#include "logos.h"

#define PAGE_HOLD_MS 3500

#define COLOR_UP     0x64dc8c
#define COLOR_FLAT   0x909090
#define COLOR_DOWN   0xff5050
#define COLOR_UNKNOWN 0x505050
#define COLOR_LABEL  0x606060
#define COLOR_STAR   0xffd23c
#define COLOR_ARROW  0x64dc8c
#define COLOR_PAUSE  0x404040

/* Pages, in the order they rotate; each item gets a week page and a month page */
static const struct {
	enum stat_bridge bridge;
	enum stat_metric metric;
	const uint8_t *logo;
} items_order[] = {
	{STAT_BRIDGE_CSHARP, STAT_METRIC_STARS, logo_csharp},
	{STAT_BRIDGE_RUST, STAT_METRIC_STARS, logo_rust},
	{STAT_BRIDGE_CSHARP, STAT_METRIC_DOWNLOADS, logo_nuget},
	{STAT_BRIDGE_RUST, STAT_METRIC_DOWNLOADS, logo_crate},
};

static const struct {
	int days;
	char label;
} periods[] = {
	{7, 'W'},
	{30, 'M'},
};

#define PAGE_COUNT (ARRAY_SIZE(items_order) * ARRAY_SIZE(periods))

static struct {
	bool have;
	uint32_t value;
} current[STAT_BRIDGE_COUNT][STAT_METRIC_COUNT];
static bool have_any;

static size_t page_index;
static bool paused;
static bool redraw;
static bool first;
static int64_t next_switch;

void app_trends_set_items(const struct stat_item *items, size_t count)
{
	for (size_t i = 0; i < count; i++) {
		current[items[i].bridge][items[i].metric].have = true;
		current[items[i].bridge][items[i].metric].value = items[i].value;
		have_any = true;
	}
	redraw = true;
}

static void draw_page(struct gfx_fb *fb)
{
	size_t item = page_index / ARRAY_SIZE(periods);
	size_t period = page_index % ARRAY_SIZE(periods);
	enum stat_bridge bridge = items_order[item].bridge;
	enum stat_metric metric = items_order[item].metric;
	bool is_stars = metric == STAT_METRIC_STARS;
	char text[12] = "--";
	uint32_t color = COLOR_UNKNOWN;
	int64_t change;
	int text_width, group_width, x;
	bool with_label;

	if (current[bridge][metric].have &&
	    history_change_over(bridge, metric, periods[period].days, current[bridge][metric].value,
				&change)) {
		format_delta(text, sizeof(text), change);
		color = change > 0 ? COLOR_UP : (change < 0 ? COLOR_DOWN : COLOR_FLAT);
	}

	gfx_sprite(fb, 0, 0, items_order[item].logo);

	/* Label (W or M), change and icon fit in the 23 pixels right of the logo, unless the
	 * change is wide: then the label is left out
	 */
	text_width = gfx_text_width(text);
	with_label = 4 + text_width + 1 + ICON_W <= GFX_W - 9;
	group_width = (with_label ? 4 : 0) + text_width + 1 + ICON_W;
	x = 9 + (GFX_W - 9 - group_width) / 2;

	if (with_label) {
		char label[2] = {periods[period].label, '\0'};

		gfx_text(fb, x, 1, label, COLOR_LABEL);
		x += 4;
	}
	gfx_text(fb, x, 1, text, color);
	gfx_mask(fb, x + text_width + 1, 1, is_stars ? icon_star : icon_arrow_down, ICON_H,
		 is_stars ? COLOR_STAR : COLOR_ARROW);

	if (paused) {
		gfx_pixel(fb, GFX_W - 1, 0, COLOR_PAUSE);
	}
}

static void enter(int64_t now)
{
	first = true;
	next_switch = now + PAGE_HOLD_MS;
}

static enum app_result update(struct gfx_fb *fb, int64_t now)
{
	if (!have_any) {
		if (first || redraw) {
			gfx_text(fb, (GFX_W - gfx_text_width("SYNC")) / 2, 1, "SYNC", COLOR_UNKNOWN);
			first = redraw = false;
			return APP_REDRAW;
		}
		return APP_IDLE;
	}

	if (first) {
		first = redraw = false;
		draw_page(fb);
		next_switch = now + PAGE_HOLD_MS;
		return APP_REDRAW;
	}

	if (!paused && now >= next_switch) {
		page_index = (page_index + 1) % PAGE_COUNT;
		next_switch = now + PAGE_HOLD_MS;
		redraw = false;
		draw_page(fb);
		return APP_SLIDE_UP;
	}

	if (redraw) {
		redraw = false;
		draw_page(fb);
		return APP_REDRAW;
	}

	return APP_IDLE;
}

static void middle(int64_t now)
{
	paused = !paused;
	next_switch = now + PAGE_HOLD_MS;
	redraw = true;
}

const struct app app_bridges_trends = {
	.title = "TREND",
	.enter = enter,
	.update = update,
	.middle = middle,
};
```

## src/battery.c
```c
/*
 * Copyright (c) 2026 Bruno Vunderl
 *
 * SPDX-License-Identifier: GPL-3.0-or-later
 */

#include <zephyr/device.h>
#include <zephyr/devicetree.h>
#include <zephyr/drivers/adc.h>
#include <zephyr/logging/log.h>

#include "battery.h"

LOG_MODULE_REGISTER(battery, LOG_LEVEL_INF);

/* The board's devicetree describes channel 6 of ADC1 (GPIO34) as the battery */
static const struct adc_dt_spec adc = ADC_DT_SPEC_STRUCT(DT_NODELABEL(adc0), 6);

/* The ADC is noisy: average this many samples */
#define SAMPLES 16

int battery_init(void)
{
	int ret;

	if (!adc_is_ready_dt(&adc)) {
		LOG_ERR("ADC not ready");
		return -ENODEV;
	}

	ret = adc_channel_setup_dt(&adc);
	if (ret) {
		LOG_ERR("ADC channel setup failed: %d", ret);
	}
	return ret;
}

int battery_millivolts(uint16_t *raw_out)
{
	uint16_t sample;
	struct adc_sequence sequence = {
		.buffer = &sample,
		.buffer_size = sizeof(sample),
	};
	uint32_t sum = 0;
	int ret;

	ret = adc_sequence_init_dt(&adc, &sequence);
	if (ret) {
		return ret;
	}

	for (int i = 0; i < SAMPLES; i++) {
		ret = adc_read_dt(&adc, &sequence);
		if (ret) {
			return ret;
		}
		sum += sample;
	}

	if (raw_out != NULL) {
		*raw_out = sum / SAMPLES;
	}

	return (int)((uint64_t)(sum / SAMPLES) * CONFIG_TC001_BATTERY_UV_PER_COUNT / 1000);
}
```

## src/battery.h
```c
/*
 * Copyright (c) 2026 Bruno Vunderl
 *
 * SPDX-License-Identifier: GPL-3.0-or-later
 */

#ifndef TC001_BATTERY_H_
#define TC001_BATTERY_H_

#include <stdbool.h>
#include <stdint.h>

/** Set up the battery voltage input. Returns 0 on success. */
int battery_init(void);

/**
 * Measure the battery voltage in millivolts, as an average of several samples. This is an
 * estimate (see CONFIG_TC001_BATTERY_UV_PER_COUNT).
 *
 * @param raw Receives the ADC count it was worked out from; may be NULL
 * @return the voltage in millivolts, or a negative errno on failure
 */
int battery_millivolts(uint16_t *raw);

/** Charge left, 0 to 100, for a lithium cell at @p millivolts. Pure function of the voltage. */
int battery_percent(int millivolts);

#endif /* TC001_BATTERY_H_ */
```

## src/battery_percent.c
```c
/*
 * Copyright (c) 2026 Bruno Vunderl
 *
 * SPDX-License-Identifier: GPL-3.0-or-later
 */

#include <zephyr/sys/util.h>

#include "battery.h"

int battery_percent(int millivolts)
{
	/*
	 * A lithium cell does not discharge linearly: it falls quickly at the top, sits on a long
	 * plateau, and drops away at the bottom. Points on a typical curve, with linear steps between.
	 */
	static const struct {
		int mv;
		int percent;
	} curve[] = {
		{3300, 0}, {3500, 8}, {3700, 25}, {3800, 42},
		{3900, 60}, {4000, 80}, {4100, 93}, {4200, 100},
	};

	if (millivolts <= curve[0].mv) {
		return 0;
	}
	for (size_t i = 1; i < ARRAY_SIZE(curve); i++) {
		if (millivolts <= curve[i].mv) {
			int span = curve[i].mv - curve[i - 1].mv;
			int into = millivolts - curve[i - 1].mv;

			return curve[i - 1].percent +
			       (curve[i].percent - curve[i - 1].percent) * into / span;
		}
	}
	return 100;
}
```

## src/brightness.c
```c
/*
 * Copyright (c) 2026 Bruno Vunderl
 *
 * SPDX-License-Identifier: GPL-3.0-or-later
 */

#include "brightness.h"
#include "gfx.h"
#include "light.h"

/* Percentage points per tick: a room light turning on fades in rather than jumping */
#define MAX_STEP 3

static int current;

static int wanted(void)
{
	const struct config *cfg = config_get();
	int raw = 0;

	if (cfg->auto_brightness) {
		raw = light_read();
		if (raw < 0) {
			return current; /* no reading: leave things as they are */
		}
	}
	return brightness_target(cfg, raw);
}

void brightness_init(void)
{
	current = wanted();
	if (current < BRIGHTNESS_MIN) {
		current = config_get()->brightness;
	}
	gfx_set_brightness(current);
}

bool brightness_tick(void)
{
	int target = wanted();
	int step = target - current;

	if (step == 0) {
		return false;
	}
	if (step > MAX_STEP) {
		step = MAX_STEP;
	} else if (step < -MAX_STEP) {
		step = -MAX_STEP;
	}

	current += step;
	gfx_set_brightness(current);
	return true;
}
```

## src/brightness.h
```c
/*
 * Copyright (c) 2026 Bruno Vunderl
 *
 * SPDX-License-Identifier: GPL-3.0-or-later
 */

#ifndef TC001_BRIGHTNESS_H_
#define TC001_BRIGHTNESS_H_

#include <stdbool.h>

#include "config.h"

#define BRIGHTNESS_MIN 5
#define BRIGHTNESS_MAX 100

/** What the light sensor says the brightness should be for @p light_raw, before any bias. */
int brightness_from_light(int light_raw);

/**
 * The brightness the settings ask for: the manual level, or with automatic brightness what the
 * light sensor reading @p light_raw calls for, moved by the bias.
 */
int brightness_target(const struct config *cfg, int light_raw);

/** Start at the brightness the settings ask for. Call once, after config_init(). */
void brightness_init(void);

/**
 * Move the LED brightness towards what the settings ask for, gently. Call about twice a second.
 *
 * @return true if the brightness changed, so what is on display should be sent again
 */
bool brightness_tick(void);

#endif /* TC001_BRIGHTNESS_H_ */
```
